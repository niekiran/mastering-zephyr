## 001_za_led_blinky/dts/bindings/led/my-gpio-leds.yaml
```yaml
description: Wrapper for gpio leds with a blink period property
compatible: "my,gpio-leds"

include: [gpio-leds.yaml]

properties:
  blink-period-ms:
    type: int
    required: false
    default: 500
```

## boards/vendor/fastbit_stm32nano/Kconfig.fastbit_stm32nano
```kconfig
config BOARD_FASTBIT_STM32NANO 
        select SOC_STM32F303XC # forces CONFIG_SOC_STM32F303XC = y
```

## boards/vendor/fastbit_stm32nano/board.yml
```yaml
board:
  name: fastbit_stm32nano
  vendor: fastbit
  revision:
    format: major.minor.patch
    default: "1.0.0"
    exact: true
    revisions:
    - name: "1.0.0"
    - name: "1.1.0" 
  socs:
  - name: stm32f303xc
    variants:
    - name: stm32f303cc
```
