## CMakeLists.txt
```
#-------------------------------------------------------------------------------
# Zephyr Example Application
#
# Copyright (c) 2021 Nordic Semiconductor ASA
# SPDX-License-Identifier: Apache-2.0

cmake_minimum_required(VERSION 3.13.1)
find_package(Zephyr REQUIRED HINTS $ENV{ZEPHYR_BASE})

project(app LANGUAGES C)

# target_sources(app PRIVATE src/main.c)

target_sources(app PRIVATE
  src/main.c
  src/led.c
  src/button.c
  src/thread.c
  src/led_flash.c
)

target_include_directories(app PRIVATE
  ${CMAKE_CURRENT_SOURCE_DIR}/include
)
```

## prj.conf
```kconfig
# Copyright (c) 2021 Nordic Semiconductor ASA
# SPDX-License-Identifier: Apache-2.0
#
# This file contains selected Kconfig options for the application.

CONFIG_UART_CONSOLE=y
CONFIG_STDOUT_CONSOLE=y
```

## src/main.c
```c
#include <zephyr/devicetree.h>
#include <stdio.h>
#include "led.h"
#include "button.h"
#include "led_flash.h"
#include "main.h"


/* If you really use led0/button0 aliases, this is the correct check */
#if !DT_NODE_HAS_STATUS(DT_ALIAS(led0), okay)
#error "Missing devicetree alias led0"
#endif

#if !DT_NODE_HAS_STATUS(DT_ALIAS(button0), okay)
#error "Missing devicetree alias button0"
#endif

static const struct gpio_dt_spec led_spec    = GPIO_DT_SPEC_GET(DT_ALIAS(led0), gpios);
static const struct gpio_dt_spec button_spec = GPIO_DT_SPEC_GET(DT_ALIAS(button0), gpios);

static struct button usr_button;
struct led_flash_ctx led_flash;

K_MSGQ_DEFINE(button_msgq, sizeof(struct button_event), 10, _Alignof(struct button_event));

void on_button(uint32_t t_ms, uint8_t state)
{
    struct button_event evt = {
        .t_ms = t_ms,
        .state = state,
    };

    if (k_msgq_put(&button_msgq, &evt, K_NO_WAIT) != 0) {
        /* optional: increment drop counter */
        /* atomic_inc(&drop_count); */
    }
}

int main(void)
{
    usr_button.button_spec = &button_spec;
    usr_button.app_cb = on_button;

    if (led_init(&led_spec) < 0) {
        return 0;
    }

    if (button_init(&usr_button) < 0) {
        return 0;
    }

    led_flash_init(&led_flash, &led_spec);

    k_sleep(K_FOREVER);
    return 0;
}
```

## include/button.h
```c
#ifndef BTN_H
#define BTN_H


typedef void (*button_isr_cb_t)(uint32_t t_ms, uint8_t level);

struct button {
 const struct gpio_dt_spec *button_spec;
 struct gpio_callback button_cb;
 button_isr_cb_t app_cb;
 //user data
};


int button_init(struct button *button);

#endif
```

## include/led.h
```c
#ifndef LED_H
#define LED_H

#include <stdint.h>
#include <stdbool.h>
#include <zephyr/drivers/gpio.h>
#include "main.h"

int led_init(const struct gpio_dt_spec *led);
int led_toggle(const struct gpio_dt_spec *led);
int led_off(const struct gpio_dt_spec *led);
bool led_get_state(void);
uint32_t led_get_blink_period_ms(void);
const char *led_get_label(void);

#endif
```

## include/led_flash.h
```c
#ifndef LED_FLASH_H
#define LED_FLASH_H

#include "main.h"

struct led_flash_ctx
{
    uint32_t toggles_remaining;
    uint32_t period_ms;
    uint32_t count;
    struct k_spinlock lock;
    struct k_work_delayable work;
    
    const struct gpio_dt_spec *led;
};

void led_flash_init(struct led_flash_ctx *led_flash, const struct gpio_dt_spec *led);
void led_flash_burst_cancel(struct led_flash_ctx *led_flash);
void led_flash_burst_start_or_restart(struct led_flash_ctx *led_flash);


#endif
```

## include/main.h
```c
#ifndef MAIN_H
#define MAIN_H


#include <errno.h>
#include <zephyr/kernel.h> 
#include <zephyr/spinlock.h>

#define NODE_IDENT_LED0        DT_ALIAS(led0)
#define NODE_IDENT_BUTTON0     DT_ALIAS(button0)

struct button_event {
    uint32_t t_ms;
    uint8_t  state;
};


#endif
```

## src/button.c
```c
#include <zephyr/drivers/gpio.h>
#include "button.h"

#define NODE_IDENT_BUTTONS    DT_PARENT(NODE_IDENT_BUTTON0)
#define BTN_LABLE          DT_PROP_OR(NODE_IDENT_BUTTON0, label, "USER_BUTTON")


void button_isr(const struct device *port, struct gpio_callback *cb, gpio_port_pins_t pins) {

    // CONTAINER_OF(ptr, type, member)
    // 'ptr' which points to the member field
    // 'type' which is the struct type that contains that member
    // 'member' which is the exact field name inside that struct, for example button_cb
    struct button *button = CONTAINER_OF(cb, struct button, button_cb);
    if(button->app_cb != NULL) {
        uint32_t t_ms = k_uptime_get_32();
        uint8_t state = (gpio_pin_get_dt(button->button_spec) > 0) ? 1U : 0U;
         button->app_cb(t_ms, state);
    }
       
}

int button_init(struct button *button)
{
    int ret;
 
    if(button == NULL || button->button_spec == NULL) {
        return -EINVAL;
    }
    
    if (!gpio_is_ready_dt(button->button_spec)) {
        return -ENODEV;
    }

    if ((ret = gpio_pin_configure_dt(button->button_spec, GPIO_INPUT)) < 0) {
        return ret;
    }

    //1. init the gpio_callback structure 
    gpio_init_callback(&button->button_cb, button_isr, BIT(button->button_spec->pin));
    //2. install the button isr (add callback)
    if ((ret = gpio_add_callback_dt(button->button_spec, &button->button_cb)) < 0) {
        return ret;
    }
    //3. confgirue the pin for interrupt(edge or level triggering)
    if ((ret = gpio_pin_interrupt_configure_dt(button->button_spec, \ 
                                        GPIO_INT_EDGE_TO_ACTIVE)) < 0) {
        return ret;
    }

    return 0;
}
```

## src/it.c
```c
#include "main.h"

void button_isr(void) {
    
}
```

## src/led.c
```c
#include "led.h"


#define NODE_IDENT_LEDS    DT_PARENT(NODE_IDENT_LED0)

#define DELAY_MS           DT_PROP_OR(NODE_IDENT_LEDS, blink_period_ms, 500)

#define LED_LABLE          DT_PROP_OR(NODE_IDENT_LED0, label, "USER_LED")

static bool led_state = false;

int led_init(const struct gpio_dt_spec *led)
{

    if(led == NULL) {
        return -EINVAL;
    }

    //Verify the device is ready with device_is_ready.
    if (!gpio_is_ready_dt(led)) {
        return -ENODEV;
    }

    led_state = false;

    //Configure the LED pin as a GPIO output with initial state off.
    return gpio_pin_configure_dt(led, GPIO_OUTPUT_INACTIVE);
}

int led_toggle(const struct gpio_dt_spec *led)
{
    if(led == NULL) {
        return -EINVAL;
    }

    int ret = gpio_pin_toggle_dt(led);
    if (ret == 0) {
        led_state = !led_state;
    }

    return ret;
}


int led_off(const struct gpio_dt_spec *led) {
    
    if(led == NULL) {
        return -EINVAL;
    }

    return gpio_pin_set_dt(led, 0);
}

bool led_get_state(void)
{
    return led_state;
}


uint32_t led_get_blink_period_ms(void)
{
    return DELAY_MS;
}


const char *led_get_label(void)
{
    return LED_LABLE;
}
```

## src/led_flash.c
```c
#include "led_flash.h"
#include "led.h"

static void led_flash_work_handler(struct k_work *work)
{
    uint32_t rem;

    struct k_work_delayable *dwork = k_work_delayable_from_work(work);
    struct led_flash_ctx *led_flash = CONTAINER_OF(dwork, struct led_flash_ctx, work);

    k_spinlock_key_t key = k_spin_lock(&led_flash->lock);

    if (led_flash->toggles_remaining == 0U) {
        k_spin_unlock(&led_flash->lock, key);
        led_off(led_flash->led);
        return;
    }

    led_flash->toggles_remaining--;
    rem = led_flash->toggles_remaining;

    k_spin_unlock(&led_flash->lock, key);

    printf("led_flash: toggles_remaining=%u\n", rem);

    led_toggle(led_flash->led);

    if (rem > 0U) {
        (void)k_work_reschedule(&led_flash->work, K_MSEC(led_flash->period_ms));
    } else {
        printf("led_flash: burst over, LED off\n");
        led_off(led_flash->led);
    }
}

void led_flash_init(struct led_flash_ctx *led_flash, const struct gpio_dt_spec *led)
{
    led_flash->period_ms = 250;
    led_flash->count = 6;
    led_flash->toggles_remaining = led_flash->count * 2U;  /* kept as requested */
    led_flash->led = led;

    led_off(led_flash->led);

    (void)k_work_init_delayable(&led_flash->work, led_flash_work_handler);
}

void led_flash_burst_start_or_restart(struct led_flash_ctx *led_flash)
{
    k_spinlock_key_t key = k_spin_lock(&led_flash->lock);
    led_flash->toggles_remaining = led_flash->count * 2U;
    k_spin_unlock(&led_flash->lock, key);

    (void)k_work_reschedule(&led_flash->work, K_MSEC(500));
}

void led_flash_burst_cancel(struct led_flash_ctx *led_flash)
{
    (void)k_work_cancel_delayable(&led_flash->work);

    k_spinlock_key_t key = k_spin_lock(&led_flash->lock);
    led_flash->toggles_remaining = 0U;
    k_spin_unlock(&led_flash->lock, key);

    led_off(led_flash->led);
}
```

## src/thread.c
```c
#include "main.h"
#include "led_flash.h"

extern struct led_flash_ctx led_flash;
extern struct k_msgq button_msgq;

static void button_evt_handler(void *p1, void *p2, void *p3);

K_THREAD_DEFINE(button_evt_tobj,
                1024,
                button_evt_handler,
                NULL, NULL, NULL,
                5,
                0,
                0);

static void button_evt_handler(void *p1, void *p2, void *p3)
{
    ARG_UNUSED(p1);
    ARG_UNUSED(p2);
    ARG_UNUSED(p3);

    struct button_event evt;

    while (1) {
        k_msgq_get(&button_msgq, &evt, K_FOREVER);

        if (evt.state) {
            printf("button: press detected at %u ms\n", evt.t_ms);
            led_flash_burst_start_or_restart(&led_flash);
        } else {
            /* release ignored */
        }
    }
}
```
